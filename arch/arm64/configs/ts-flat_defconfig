## arch/arm64/configs/ts-flat_defconfig
```kconfig
CONFIG_WLAN_HERO=y
CONFIG_LCD_ESD_IDLE_MODE=y
CONFIG_PANEL_S6E3HA3_DYNAMIC=y
# CONFIG_PANEL_DUALIZATION is not set
CONFIG_SENSORS_SX9310_NORMAL_TOUCH_THRESHOLD=176
```
